// Generated by tools/esp8266_audio_profile/generate_aac_prefix.js; do not edit.
// Packed canonical symbol (signed low 16 bits) and code length (high 16).
// Zero entry uses the exact canonical fallback. Flash only; no pointer table.
static constexpr unsigned AAC_HUFFMAN_PREFIX_BITS = 6;
static const uint32_t aacHuffmanPrefix[12][64] PROGMEM = {
    {
        0x00010000, 0x00010000, 0x00010000, 0x00010000, 0x00010000, 0x00010000, 0x00010000, 0x00010000,
        0x00010000, 0x00010000, 0x00010000, 0x00010000, 0x00010000, 0x00010000, 0x00010000, 0x00010000,
        0x00010000, 0x00010000, 0x00010000, 0x00010000, 0x00010000, 0x00010000, 0x00010000, 0x00010000,
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        0x00000000, 0x00000000, 0x00000000, 0x00000000, 0x00000000, 0x00000000, 0x00000000, 0x00000000,
    },
    {
        0x00030000, 0x00030000, 0x00030000, 0x00030000, 0x00030000, 0x00030000, 0x00030000, 0x00030000,
        0x00040200, 0x00040200, 0x00040200, 0x00040200, 0x00050e00, 0x00050e00, 0x00050001, 0x00050001,
        0x00050038, 0x00050038, 0x00050007, 0x00050007, 0x000501c0, 0x000501c0, 0x00050008, 0x00050008,
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        0x00000000, 0x00000000, 0x00000000, 0x00000000, 0x00000000, 0x00000000, 0x00000000, 0x00000000,
    },
    {
        0x00010000, 0x00010000, 0x00010000, 0x00010000, 0x00010000, 0x00010000, 0x00010000, 0x00010000,
        0x00010000, 0x00010000, 0x00010000, 0x00010000, 0x00010000, 0x00010000, 0x00010000, 0x00010000,
        0x00010000, 0x00010000, 0x00010000, 0x00010000, 0x00010000, 0x00010000, 0x00010000, 0x00010000,
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        0x00062201, 0x00063248, 0x00000000, 0x00000000, 0x00000000, 0x00000000, 0x00000000, 0x00000000,
    },
    {
        0x00044249, 0x00044249, 0x00044249, 0x00044249, 0x00043049, 0x00043049, 0x00043049, 0x00043049,
        0x00043241, 0x00043241, 0x00043241, 0x00043241, 0x00043248, 0x00043248, 0x00043248, 0x00043248,
        0x00043209, 0x00043209, 0x00043209, 0x00043209, 0x00041200, 0x00041200, 0x00041200, 0x00041200,
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        0x00000000, 0x00000000, 0x00000000, 0x00000000, 0x00000000, 0x00000000, 0x00000000, 0x00000000,
    },
    {
        0x00010000, 0x00010000, 0x00010000, 0x00010000, 0x00010000, 0x00010000, 0x00010000, 0x00010000,
        0x00010000, 0x00010000, 0x00010000, 0x00010000, 0x00010000, 0x00010000, 0x00010000, 0x00010000,
        0x00010000, 0x00010000, 0x00010000, 0x00010000, 0x00010000, 0x00010000, 0x00010000, 0x00010000,
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        0x00000000, 0x00000000, 0x00000000, 0x00000000, 0x00000000, 0x00000000, 0x00000000, 0x00000000,
    },
    {
        0x00040000, 0x00040000, 0x00040000, 0x00040000, 0x00040020, 0x00040020, 0x00040020, 0x00040020,
        0x0004001f, 0x0004001f, 0x0004001f, 0x0004001f, 0x00040001, 0x00040001, 0x00040001, 0x00040001,
        0x000403e0, 0x000403e0, 0x000403e0, 0x000403e0, 0x00040021, 0x00040021, 0x00040021, 0x00040021,
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        0x00000000, 0x00000000, 0x00000000, 0x00000000, 0x00000000, 0x00000000, 0x00000000, 0x00000000,
    },
    {
        0x00010000, 0x00010000, 0x00010000, 0x00010000, 0x00010000, 0x00010000, 0x00010000, 0x00010000,
        0x00010000, 0x00010000, 0x00010000, 0x00010000, 0x00010000, 0x00010000, 0x00010000, 0x00010000,
        0x00010000, 0x00010000, 0x00010000, 0x00010000, 0x00010000, 0x00010000, 0x00010000, 0x00010000,
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        0x00000000, 0x00000000, 0x00000000, 0x00000000, 0x00000000, 0x00000000, 0x00000000, 0x00000000,
    },
    {
        0x00030821, 0x00030821, 0x00030821, 0x00030821, 0x00030821, 0x00030821, 0x00030821, 0x00030821,
        0x00040841, 0x00040841, 0x00040841, 0x00040841, 0x00040420, 0x00040420, 0x00040420, 0x00040420,
        0x00040822, 0x00040822, 0x00040822, 0x00040822, 0x00040401, 0x00040401, 0x00040401, 0x00040401,
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        0x00000000, 0x00000000, 0x00000000, 0x00000000, 0x00000000, 0x00000000, 0x00000000, 0x00000000,
    },
    {
        0x00010000, 0x00010000, 0x00010000, 0x00010000, 0x00010000, 0x00010000, 0x00010000, 0x00010000,
        0x00010000, 0x00010000, 0x00010000, 0x00010000, 0x00010000, 0x00010000, 0x00010000, 0x00010000,
        0x00010000, 0x00010000, 0x00010000, 0x00010000, 0x00010000, 0x00010000, 0x00010000, 0x00010000,
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        0x00000000, 0x00000000, 0x00000000, 0x00000000, 0x00000000, 0x00000000, 0x00000000, 0x00000000,
    },
    {
        0x00040821, 0x00040821, 0x00040821, 0x00040821, 0x00040822, 0x00040822, 0x00040822, 0x00040822,
        0x00040841, 0x00040841, 0x00040841, 0x00040841, 0x00050842, 0x00050842, 0x00050420, 0x00050420,
        0x00050401, 0x00050401, 0x00050823, 0x00050823, 0x00050862, 0x00050862, 0x00050861, 0x00050861,
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        0x00000000, 0x00000000, 0x00000000, 0x00000000, 0x00000000, 0x00000000, 0x00000000, 0x00000000,
    },
    {
        0x00040000, 0x00040000, 0x00040000, 0x00040000, 0x00042041, 0x00042041, 0x00042041, 0x00042041,
        0x00052410, 0x00052410, 0x00051040, 0x00051040, 0x00051001, 0x00051001, 0x00052081, 0x00052081,
        0x00052042, 0x00052042, 0x00052082, 0x00052082, 0x00062043, 0x000620c1, 0x000620c2, 0x00061080,
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        0x00000000, 0x00000000, 0x00000000, 0x00000000, 0x00000000, 0x00000000, 0x00000000, 0x00000000,
    },
    {
        0x00010000, 0x00010000, 0x00010000, 0x00010000, 0x00010000, 0x00010000, 0x00010000, 0x00010000,
        0x00010000, 0x00010000, 0x00010000, 0x00010000, 0x00010000, 0x00010000, 0x00010000, 0x00010000,
        0x00010000, 0x00010000, 0x00010000, 0x00010000, 0x00010000, 0x00010000, 0x00010000, 0x00010000,
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        0x0006fffc, 0x00060004, 0x0006fffb, 0x00060005, 0x00000000, 0x00000000, 0x00000000, 0x00000000,
    },
};
