## Small_TV/src/sdkconfig.defaults
```kconfig
CONFIG_IDF_TARGET="esp32c2"
CONFIG_XTAL_FREQ_26=y
CONFIG_ESP_DEFAULT_CPU_FREQ_MHZ_120=y
CONFIG_ESPTOOLPY_FLASHMODE_DIO=y
CONFIG_ESPTOOLPY_FLASHFREQ_30M=y
CONFIG_ESPTOOLPY_FLASHSIZE_4MB=y
CONFIG_PARTITION_TABLE_CUSTOM=y
CONFIG_PARTITION_TABLE_CUSTOM_FILENAME="partitions.csv"
CONFIG_ESP_MAIN_TASK_STACK_SIZE=4096
CONFIG_LWIP_SNTP_MAX_SERVERS=3
CONFIG_MBEDTLS_CERTIFICATE_BUNDLE=y
CONFIG_MBEDTLS_CERTIFICATE_BUNDLE_DEFAULT_CMN=y
CONFIG_MBEDTLS_SSL_IN_CONTENT_LEN=4096
CONFIG_MBEDTLS_SSL_OUT_CONTENT_LEN=4096
CONFIG_ESP_WIFI_STATIC_RX_BUFFER_NUM=4
CONFIG_ESP_WIFI_DYNAMIC_RX_BUFFER_NUM=8
CONFIG_ESP_WIFI_DYNAMIC_TX_BUFFER_NUM=8
CONFIG_ESP_WIFI_TX_BUFFER_TYPE=1
CONFIG_ESP_WIFI_IRAM_OPT=n
CONFIG_ESP_WIFI_RX_IRAM_OPT=n
CONFIG_COMPILER_OPTIMIZATION_SIZE=y
CONFIG_COMPILER_OPTIMIZATION_ASSERTIONS_ENABLE=y
```

## esp8266/karadio-helix-pdm/main/Kconfig.projbuild
```kconfig
menu "KaRadio Helix ESP8266 options"

choice YORADIO_MP3_DECODER
    prompt "MP3 decoder backend"
    default YORADIO_MP3_DECODER_HELIX
config YORADIO_MP3_DECODER_HELIX
    bool "yoRadio Helix MP3"
config YORADIO_MP3_DECODER_LIBMAD
    bool "libmad-8266 (experimental)"
endchoice

config YORADIO_HELIX_MP3_SSO
    bool "Use fast 32-bit Helix MP3 synthesis"
    depends on YORADIO_MP3_DECODER_HELIX
    default y

config YORADIO_HELIX_AAC
    bool "Enable Helix AAC decoder"
    default n

config YORADIO_HELIX_AAC_SSO
    bool "Use reduced-precision Helix AAC arithmetic"
    depends on YORADIO_HELIX_AAC
    default n

choice YORADIO_AUDIO_OUTPUT
    prompt "Audio output backend"
    default YORADIO_AUDIO_OUTPUT_I2S_PDM
config YORADIO_AUDIO_OUTPUT_I2S_PDM
    bool "I2S DMA PDM on GPIO3"
config YORADIO_AUDIO_OUTPUT_SPI_PDM
    bool "HSPI PDM on GPIO13"
config YORADIO_AUDIO_OUTPUT_I2S_PCM
    bool "Standard I2S PCM"
endchoice

choice YORADIO_SPI_PDM_OVERSAMPLE
    prompt "Legacy SPI-PDM bits per PCM sample"
    default YORADIO_SPI_PDM_OVERSAMPLE_8
config YORADIO_SPI_PDM_OVERSAMPLE_8
    bool "8 bits/sample"
config YORADIO_SPI_PDM_OVERSAMPLE_16
    bool "16 bits/sample"
endchoice

choice YORADIO_I2S_PDM_OVERSAMPLE
    prompt "I2S-PDM carrier"
    depends on YORADIO_AUDIO_OUTPUT_I2S_PDM
    default YORADIO_I2S_PDM_OVERSAMPLE_32
config YORADIO_I2S_PDM_OVERSAMPLE_32
    bool "PDM32 at nominal 1.536 MHz"
config YORADIO_I2S_PDM_OVERSAMPLE_128
    bool "PDM128 at nominal 6.144 MHz"
endchoice

config YORADIO_WEB_SEND_TIMEOUT_SECONDS
    int "Web send timeout"
    range 1 30
    default 15

config YORADIO_WIFI_RECOVERY_AP_TIMEOUT_SECONDS
    int "Recovery AP delay"
    range 5 300
    default 30

config YORADIO_OLED
    bool "Enable SSD1306 OLED"
    default n

config YORADIO_STATUS_LED
    bool "Enable status LED"
    default n
    depends on YORADIO_AUDIO_OUTPUT_SPI_PDM

endmenu
```

## esp8266/rtos-sdk-native/main/Kconfig.projbuild
```kconfig
menu "yoRadio ESP8266 options"

choice YORADIO_AUDIO_CHANNELS
    prompt "Decoded audio channels"
    default YORADIO_AUDIO_STEREO if YORADIO_AUDIO_OUTPUT_I2S_PCM
    default YORADIO_AUDIO_MONO
    help
        Mono produces (L+R)/2. Helix MP3 skips the side channel in compatible
        M/S frames without intensity stereo, with one IMDCT and one synthesis.
        Other MP3 modes retain a safe downmix path. AAC and libmad downmix
        after decoding. Stereo preserves both channels; a stereo DAC requires
        the I2S PCM backend (the one-pin PDM outputs are physically mono).

config YORADIO_AUDIO_MONO
    bool "Mono"

config YORADIO_AUDIO_STEREO
    bool "Stereo"

endchoice

choice YORADIO_MP3_DECODER
    prompt "MP3 decoder backend"
    default YORADIO_MP3_DECODER_HELIX
    help
        Select the native MP3 decoder. Helix remains the production default;
        libmad-8266 is an experimental fixed-point backend used for speed,
        memory, and PCM-quality comparisons on the physical ESP8266.

config YORADIO_MP3_DECODER_HELIX
    bool "yoRadio Helix MP3 (production)"

config YORADIO_MP3_DECODER_LIBMAD
    bool "libmad-8266 from ESP8266Audio (experimental)"

endchoice

config YORADIO_HELIX_MP3_SSO
    bool "Use reduced-precision 32-bit Helix MP3 synthesis (experimental)"
    depends on YORADIO_MP3_DECODER_HELIX
    default n
    help
        Distribute the polyphase fixed-point shifts across the input samples,
        coefficients, and PCM conversion so the ESP8266 LX106 can use native
        32-bit multiply/accumulate operations. This adds no decoder buffers
        but trades a small amount of PCM precision for synthesis speed.

config YORADIO_HELIX_AAC
    bool "Enable Helix AAC decoder"
    default y
    help
        Build AAC support into the ESP8266 firmware. MP3 and AAC share the
        preallocated codec arena; AAC-enabled builds reserve a complete
        stereo AAC PCM frame.

config YORADIO_HELIX_AAC_SSO
    bool "Use reduced-precision 32-bit Helix AAC arithmetic (experimental)"
    depends on YORADIO_HELIX_AAC
    default n
    help
        Approximate AAC fixed-point high-half products with three native LX106
        16 x 16 multiplies, omitting only the low x low partial product. This
        shortens the transform hot path without allocating another buffer, at
        the cost of a small PCM precision loss.

choice YORADIO_AUDIO_OUTPUT
    prompt "Audio output backend"
    default YORADIO_AUDIO_OUTPUT_I2S_PDM
    help
        I2S-PDM is the production default. SLC DMA continuously clocks a
        one-bit delta-sigma stream on fixed GPIO3 without the inter-block gap
        of the single-buffer HSPI peripheral. GPIO3 is UART0 RX, so the
        application intentionally ignores UART input while audio is active.

config YORADIO_AUDIO_OUTPUT_I2S_PDM
    bool "I2S DMA PDM on GPIO3 (production)"

config YORADIO_AUDIO_OUTPUT_I2S_RCPDM
    bool "I2S RCPDM on GPIO3 (experimental)"
    help
        Predict the output RC voltage with an unsigned 32-bit model and
        alpha=1/16. Continuous I2S/SLC DMA transports exactly 32 bits per
        48-kHz output PCM sample (nominal 1.536 MHz, actual 1.538462 MHz).
        Use a matched RC filter (1 kohm, approximately 10 nF) and a
        high-impedance, AC-coupled amplifier input. GPIO3 is still UART RX.
        This is a separate modulator, not the production delta-sigma PDM.

config YORADIO_AUDIO_OUTPUT_SPI_PDM
    bool "HSPI PDM on GPIO13 (legacy UART-safe)"

config YORADIO_AUDIO_OUTPUT_I2S_PCM
    bool "Standard I2S PCM for an external DAC"

endchoice

config YORADIO_RCPDM_FEEDBACK
    bool "RC-PDM with error feedback, interpolation and dither (experimental)"
    depends on YORADIO_AUDIO_OUTPUT_I2S_RCPDM
    default n
    help
        Preserve low-level PCM by accumulating tracking error. Uses causal
        linear interpolation and deterministic TPDF decision dither. The RC
        shift remains 4 at the fixed 1.536-MHz/32-bit carrier. Modulator state
        grows from 4 to 16 bytes; DMA buffers are unchanged. This changes the
        bitstream and is not a bit-exact optimization of the original RC-PDM.

choice YORADIO_SPI_PDM_OVERSAMPLE
    prompt "Legacy SPI-PDM bits per PCM sample"
    default YORADIO_SPI_PDM_OVERSAMPLE_8
    help
        Select the one-bit PDM oversampling ratio used by the legacy SPI
        output. Eight bits gives 384.615 kHz; sixteen bits lowers quantization
        noise at twice the conversion and output bandwidth.

config YORADIO_SPI_PDM_OVERSAMPLE_8
    bool "8 bits/sample (384.615 kHz at 48 kHz)"

config YORADIO_SPI_PDM_OVERSAMPLE_16
    bool "16 bits/sample (769.231 kHz at 48 kHz)"

endchoice

choice YORADIO_I2S_PDM_OVERSAMPLE
    prompt "I2S-PDM carrier and delta-sigma mode"
    depends on YORADIO_AUDIO_OUTPUT_I2S_PDM
    default YORADIO_I2S_PDM_OVERSAMPLE_32
    help
        Production computes 32 delta-sigma bits per 48-kHz PCM sample at a
        nominal 1.536-MHz carrier. PDM128 raises the carrier to 6.144 MHz and
        remains experimental. ESP8266 integer dividers are +0.16% high.

config YORADIO_I2S_PDM_OVERSAMPLE_32
    bool "PDM32 genuine (1.536 MHz carrier, production)"

config YORADIO_I2S_PDM_OVERSAMPLE_128
    bool "PDM128 genuine (6.144 MHz carrier, experimental)"

endchoice

config YORADIO_PLAYLIST_WEB_GZIP
    bool "Cache a compressed WebUI playlist in SPIFFS"
    default y
    help
        Build a bounded-memory gzip representation after a playlist upload.
        Reuse it on boot after source/body CRC validation and stream it to
        browsers without recompressing per request. Requires about 4.3 KiB
        temporary RAM during generation, and compressed-list space in SPIFFS.
        The original CSV and station index remain authoritative. If disabled,
        the encoder and cache implementation are excluded and the WebUI uses
        ordinary bounded CSV streaming. Existing cache files are left intact.

config YORADIO_WEB_SEND_TIMEOUT_SECONDS
    int "Web content send timeout (seconds)"
    range 1 30
    default 15
    help
        Maximum time the shared HTTP task waits for one stalled socket send.
        Keep this short because one blocked client otherwise stops WebSocket
        and static-file service for every browser.

config YORADIO_WIFI_RECOVERY_AP_TIMEOUT_SECONDS
    int "Recovery access point delay (seconds)"
    range 5 300
    default 30
    help
        Start the recovery access point after this many seconds without a
        successful client-mode Wi-Fi connection.

config YORADIO_STREAM_INPUT_BYTES
    int "Compressed audio input buffer (bytes)"
    range 1536 8192
    default 4096
    help
        Reuse the decoder input as a queue, without a separate FIFO/task.
        4096 bytes leaves 2048 more DRAM bytes than the previous 6144-byte
        default. Larger values remain selectable but need
        on-board heap/stack and WebUI stress testing for both MP3 and AAC.

config YORADIO_STREAM_PREFILL_MS
    int "Maximum initial input prefill time (milliseconds, 0 = disabled)"
    range 0 5000
    default 1000
    help
        Before decoding, try to fill the entire compressed input buffer.
        Start sooner if it fills, or with the available bytes at the deadline.
        Stop/station changes cancel the wait. During playback, top up with
        immediately available data before each frame without waiting to fill.

config YORADIO_STREAM_IDLE_TIMEOUT_MS
    int "Radio stream receive inactivity timeout (milliseconds)"
    range 250 60000
    default 1000
    help
        Reopen the radio TCP/HTTP stream after this interval without received
        data. Reads remain nonblocking before the deadline. A short timeout
        restores a stalled stream sooner but reconnects more often when Wi-Fi
        packets are delayed. This is not the HTTP connection/header timeout.

config YORADIO_STREAM_READ_WAIT_MS
    int "Maximum socket readiness wait after EAGAIN (0 = legacy polling)"
    range 0 50
    default 0
    help
        Wait for a readable socket instead of polling it every millisecond.
        Cancellation is checked before and after each bounded wait. This
        does not change the stream inactivity timeout or add an input buffer.

config YORADIO_OLED
    bool "Enable SSD1306 OLED display"
    default n
    help
        Build the optional SSD1306 display task. Keep this disabled for the
        lowest-RAM WebUI-only firmware profile.

config YORADIO_STATUS_LED
    bool "Enable audio-level LED on GPIO2"
    default y
    depends on YORADIO_AUDIO_OUTPUT_SPI_PDM || YORADIO_AUDIO_OUTPUT_I2S_PDM || YORADIO_AUDIO_OUTPUT_I2S_RCPDM
    help
        The active-low ESP-12F/Wemos LED follows the post-volume audio peak.
        GPIO sigma-delta generates brightness pulses in hardware, without a
        software PWM interrupt or another task. Stopped/muted audio is dark.
        NoDAC I2S keeps BCLK/WS internal; external-DAC I2S owns GPIO2 as WS
        and cannot use this LED. Reserves the single GPIO sigma-delta unit.

config YORADIO_STATUS_LED_UPDATE_HZ
    int "Audio-level LED updates per second"
    depends on YORADIO_STATUS_LED
    range 10 20
    default 20
    help
        20 Hz updates brightness every 50 ms; 10 Hz every 100 ms. This is
        the envelope refresh rate, not the hardware pulse frequency.

config YORADIO_STATUS_LED_MAX_BRIGHTNESS
    int "Audio-level LED maximum brightness (0-255)"
    depends on YORADIO_STATUS_LED
    range 0 255
    default 255

config YORADIO_STATUS_LED_DECAY_STEP
    int "Audio-level LED decay per 50 ms (1-255)"
    depends on YORADIO_STATUS_LED
    range 1 255
    default 8
    help
        Match the ESP32-C3 peak envelope: fast attack and slower release.
        At 10 Hz the step is doubled to keep the same release duration.

endmenu
```

## esp8266/rtos-sdk-native/sdkconfig.defaults
```kconfig
CONFIG_IDF_TARGET="esp8266"
CONFIG_ESPTOOLPY_FLASHMODE_DIO=y
CONFIG_ESPTOOLPY_FLASHFREQ_40M=y
CONFIG_ESPTOOLPY_FLASHSIZE_4MB=y
CONFIG_ESPTOOLPY_MONITOR_BAUD=115200
CONFIG_PARTITION_TABLE_CUSTOM=y
CONFIG_PARTITION_TABLE_CUSTOM_FILENAME="partitions.csv"

CONFIG_ESP8266_DEFAULT_CPU_FREQ_160=y
CONFIG_FREERTOS_HZ=1000
CONFIG_ESP_MAIN_TASK_STACK_SIZE=4096
CONFIG_ESP_CONSOLE_UART_DEFAULT=y
CONFIG_ESP_CONSOLE_UART_BAUDRATE=115200

CONFIG_COMPILER_OPTIMIZATION_LEVEL_RELEASE=y
CONFIG_COMPILER_OPTIMIZATION_ASSERTIONS_SILENT=y
CONFIG_COMPILER_CXX_EXCEPTIONS=n

CONFIG_LOG_DEFAULT_LEVEL_INFO=y
CONFIG_LOG_BOOTLOADER_LEVEL_WARN=y
CONFIG_ESP8266_CORE_DUMP_DISABLE=y

CONFIG_LWIP_TCP_WND_DEFAULT=11520
CONFIG_LWIP_TCP_RECVMBOX_SIZE=10
CONFIG_LWIP_IPV6=n

# The target is intentionally HTTP-only. No TLS certificate bundle and no
# HTTPS OTA are linked by the application.
```

## idf/components/audio_level_led/Kconfig
```kconfig
menu "yoRadio audio level LED"

menuconfig YORADIO_AUDIO_LEVEL_LED
    bool "Enable PWM audio level LED"
    default n
    help
        Drive an ordinary single-color LED from the strongest decoded audio
        peak. Keep this disabled unless the selected GPIO is safe on the
        target board. This is not a WS2812/addressable-LED driver.

if YORADIO_AUDIO_LEVEL_LED

config YORADIO_AUDIO_LEVEL_LED_GPIO
    int "LED GPIO"
    range 0 48
    default 8

config YORADIO_AUDIO_LEVEL_LED_ACTIVE_LOW
    bool "LED is active low"
    default y
    help
        Enable when a lower PWM duty at the GPIO produces more light.

config YORADIO_AUDIO_LEVEL_LED_PWM_HZ
    int "PWM frequency (Hz)"
    range 100 40000
    default 5000

config YORADIO_AUDIO_LEVEL_LED_MAX_BRIGHTNESS
    int "Maximum brightness (1..255 duty)"
    range 1 255
    default 255

config YORADIO_AUDIO_LEVEL_LED_UPDATE_MS
    int "Peak update interval (ms)"
    range 10 1000
    default 50

config YORADIO_AUDIO_LEVEL_LED_DECAY_STEP
    int "Envelope decay per update (0..255)"
    range 1 255
    default 8

endif

endmenu
```

## idf/components/custom_legacy_codecs/Kconfig
```kconfig
menu "yoRadio codec backends"

choice YORADIO_MP3_DECODER
    prompt "MP3 decoder implementation"
    default YORADIO_MP3_DECODER_MINIMP3
    help
        Select one MP3 decoder at build time. Helix and minimp3 reuse the
        codec sources shipped with yoRadio; Espressif uses esp_audio_codec.

    config YORADIO_MP3_DECODER_ESPRESSIF
        bool "Espressif esp_audio_codec MP3"

    config YORADIO_MP3_DECODER_HELIX
        bool "yoRadio Helix MP3"

    config YORADIO_MP3_DECODER_MINIMP3
        bool "yoRadio minimp3 (recommended)"
endchoice

choice YORADIO_AAC_DECODER
    prompt "AAC decoder implementation"
    default YORADIO_AAC_DECODER_ESPRESSIF
    help
        Select one AAC decoder at build time. The yoRadio decoder is the
        fixed-point Helix AAC-LC implementation and does not enable SBR on C3.

    config YORADIO_AAC_DECODER_ESPRESSIF
        bool "Espressif esp_audio_codec AAC (recommended)"

    config YORADIO_AAC_DECODER_HELIX
        bool "yoRadio Helix AAC-LC"
endchoice

endmenu
```
