## tests/target/cyd_espressif_opus_long_task_qemu/project/main/Kconfig.projbuild
```kconfig
menu "Actual CYD public vendor task diagnostic"
config YORADIO_FLAC_DECODER_CUSTOM
 bool
 default n
config YORADIO_MP3_DECODER_ESPRESSIF
 bool
 default y
config YORADIO_AAC_DECODER_ESPRESSIF
 bool
 default y
config YORADIO_ADAPTIVE_INPUT_BUFFER
 bool
 default y
config YORADIO_FRAME_ROUTER
 bool
 default y
config YORADIO_STREAM_CONFIRM
 bool
 default y
config YORADIO_INPUT_TAIL_COALESCE
 bool
 default y
config YORADIO_INPUT_PREFILL_MS
 int
 default 0
config YORADIO_HTTP_REQUEST_BUFFER_RELEASE
 bool
 default n
endmenu
```

## tests/target/cyd_espressif_opus_task_qemu/project/sdkconfig.defaults
```kconfig
CONFIG_IDF_TARGET="esp32"
CONFIG_ESPTOOLPY_FLASHMODE_DIO=y
CONFIG_ESPTOOLPY_FLASHFREQ_40M=y
CONFIG_ESPTOOLPY_FLASHSIZE_4MB=y
CONFIG_PARTITION_TABLE_CUSTOM=y
CONFIG_PARTITION_TABLE_CUSTOM_FILENAME="partitions.csv"
CONFIG_ESP_DEFAULT_CPU_FREQ_MHZ_240=y
# CONFIG_FREERTOS_UNICORE is not set
CONFIG_FREERTOS_HZ=1000
CONFIG_FREERTOS_CHECK_STACKOVERFLOW_CANARY=y
CONFIG_COMPILER_OPTIMIZATION_ASSERTIONS_ENABLE=y
CONFIG_COMPILER_OPTIMIZATION_PERF=y
# CONFIG_COMPILER_CXX_EXCEPTIONS is not set
# CONFIG_COMPILER_CXX_RTTI is not set
CONFIG_ESP_MAIN_TASK_STACK_SIZE=6144
CONFIG_ESP_CONSOLE_UART_DEFAULT=y
CONFIG_HEAP_POISONING_LIGHT=y
CONFIG_ESP_TASK_WDT_EN=y
CONFIG_ESP_TASK_WDT_INIT=y
CONFIG_ESP_TASK_WDT_PANIC=y
CONFIG_ESP_TASK_WDT_CHECK_IDLE_TASK_CPU0=y
CONFIG_ESP_TASK_WDT_CHECK_IDLE_TASK_CPU1=y
CONFIG_ESP_TASK_WDT_TIMEOUT_S=20
CONFIG_ESP_INT_WDT=y
CONFIG_ESP_INT_WDT_TIMEOUT_MS=1000
CONFIG_LOG_DEFAULT_LEVEL_INFO=y
CONFIG_BOOTLOADER_LOG_LEVEL_INFO=y
CONFIG_MBEDTLS_CERTIFICATE_BUNDLE=y
CONFIG_AUDIO_DECODER_AAC_SUPPORT=y
CONFIG_AUDIO_DECODER_MP3_SUPPORT=y
CONFIG_AUDIO_DECODER_FLAC_SUPPORT=y
CONFIG_AUDIO_DECODER_OPUS_SUPPORT=y
CONFIG_AUDIO_DECODER_VORBIS_SUPPORT=y
CONFIG_AUDIO_SIMPLE_DEC_OGG_SUPPORT=y
# CONFIG_YORADIO_HTTP_REQUEST_BUFFER_RELEASE is not set
```

## tests/target/cyd_ogg_runtime_controls_qemu/project/main/Kconfig.projbuild
```kconfig
menu "Actual CYD public vendor task diagnostic"
config YORADIO_NATIVE_AUDIO_OUTPUT_PDM
 bool
 default y
config YORADIO_OGG_TIMELINE
 bool
 default y
config YORADIO_FLAC_DECODER_CUSTOM
 bool
 default n
config YORADIO_MP3_DECODER_ESPRESSIF
 bool
 default y
config YORADIO_AAC_DECODER_ESPRESSIF
 bool
 default y
config YORADIO_AAC_PLUS
 bool
 default y
config YORADIO_ADAPTIVE_INPUT_BUFFER
 bool
 default y
config YORADIO_FRAME_ROUTER
 bool
 default y
config YORADIO_STREAM_CONFIRM
 bool
 default y
config YORADIO_INPUT_TAIL_COALESCE
 bool
 default y
config YORADIO_INPUT_PREFILL_MS
 int
 default 0
config YORADIO_HTTP_REQUEST_BUFFER_RELEASE
 bool
 default n
endmenu
```
