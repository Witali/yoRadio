## idf/esp32-cyd2usb-native/main/Kconfig.projbuild
```kconfig
menu "yoRadio native firmware"

    config YORADIO_ADAPTIVE_INPUT_BUFFER
        bool "Leased compressed input queue"
        default y
        help
            Keep at least four packet slots with an eight-slot budget. Queue
            leases and SMP locks protect published data from reclamation.

    config YORADIO_FRAME_ROUTER
        bool "MP3/ADTS frame routing and codec drain"
        depends on YORADIO_ADAPTIVE_INPUT_BUFFER
        default y

    config YORADIO_STREAM_CONFIRM
        bool "Continuous bounded frame confirmation"
        depends on YORADIO_FRAME_ROUTER
        default y
        help
            Confirm the next boundary before publishing a candidate frame.
            Share startup storage with input slots and keep an independent
            control node for replay/drain/completion without a fifth slot.

    config YORADIO_INPUT_TAIL_COALESCE
        bool "Coalesce short reads into a queued data tail"
        depends on YORADIO_FRAME_ROUTER
        default y
        help
            Only the producer reopens a partial READY tail. Never modify a
            READING lease, the sole queued node, or a control packet.

    choice YORADIO_NATIVE_AUDIO_OUTPUT
        prompt "Default audio output"
        default YORADIO_NATIVE_AUDIO_OUTPUT_PDM

        config YORADIO_NATIVE_AUDIO_OUTPUT_PDM
            bool "I2S hardware PCM-to-PDM on GPIO26"
            help
                Use the ESP32 I2S0 PCM-to-PDM converter. The hardware side
                runs at 48 kHz with a 6.144 MHz PDM carrier; lower-rate input
                streams are resampled to 48 kHz.

        config YORADIO_NATIVE_AUDIO_OUTPUT_DAC
            bool "Internal 8-bit DAC on GPIO26"
            help
                Use the ESP32 internal DAC continuous-mode driver.

        config YORADIO_NATIVE_AUDIO_OUTPUT_LEGACY_DAC
            bool "Legacy ESP-IDF 5.5 I2S/DAC on GPIO26"
            help
                Compile Espressif's final legacy I2S built-in-DAC driver from
                the pinned ESP-IDF v5.5.4 source tree. PCM is oversampled x16
                and its fractional low byte is noise-shaped between adjacent
                8-bit DAC codes. This is intended as a compatibility and
                audio-quality comparison backend.

    endchoice

endmenu
```

## idf/esp32-cyd2usb-native/sdkconfig.defaults
```kconfig
CONFIG_IDF_TARGET="esp32"
CONFIG_ESPTOOLPY_FLASHMODE_QIO=y
CONFIG_ESPTOOLPY_FLASHFREQ_80M=y
CONFIG_ESPTOOLPY_FLASHSIZE_4MB=y
CONFIG_ESPTOOLPY_MONITOR_BAUD=115200
CONFIG_PARTITION_TABLE_CUSTOM=y
CONFIG_PARTITION_TABLE_CUSTOM_FILENAME="partitions.csv"

CONFIG_ESP_DEFAULT_CPU_FREQ_MHZ_240=y
CONFIG_FREERTOS_UNICORE=n
CONFIG_FREERTOS_HZ=1000

CONFIG_COMPILER_OPTIMIZATION_PERF=y
CONFIG_COMPILER_CXX_EXCEPTIONS=n
CONFIG_COMPILER_CXX_RTTI=n
CONFIG_LIBC_NEWLIB_NANO_FORMAT=y
CONFIG_LOG_DEFAULT_LEVEL_INFO=y
CONFIG_LOG_MAXIMUM_LEVEL=3
CONFIG_BOOTLOADER_LOG_LEVEL_WARN=y
CONFIG_ESP_SYSTEM_PANIC_PRINT_REBOOT=y
CONFIG_ESP_COREDUMP_ENABLE_TO_NONE=y
CONFIG_HEAP_POISONING_DISABLED=y
CONFIG_FREERTOS_USE_TRACE_FACILITY=n
CONFIG_FREERTOS_GENERATE_RUN_TIME_STATS=n

# Native decoder set. Only one decoder instance is created at a time.
CONFIG_AUDIO_DECODER_AAC_SUPPORT=y
CONFIG_AUDIO_DECODER_MP3_SUPPORT=y
CONFIG_AUDIO_DECODER_FLAC_SUPPORT=y
CONFIG_AUDIO_DECODER_OPUS_SUPPORT=y
CONFIG_AUDIO_DECODER_VORBIS_SUPPORT=y
CONFIG_AUDIO_DECODER_G711_SUPPORT=n
CONFIG_AUDIO_DECODER_AMRNB_SUPPORT=n
CONFIG_AUDIO_DECODER_AMRWB_SUPPORT=n
CONFIG_AUDIO_DECODER_ADPCM_SUPPORT=n
CONFIG_AUDIO_DECODER_ALAC_SUPPORT=n
CONFIG_AUDIO_DECODER_PCM_SUPPORT=n
CONFIG_AUDIO_DECODER_SBC_SUPPORT=n
CONFIG_AUDIO_DECODER_LC3_SUPPORT=n
CONFIG_AUDIO_DECODER_G722_SUPPORT=n
CONFIG_AUDIO_SIMPLE_DEC_OGG_SUPPORT=y
CONFIG_AUDIO_SIMPLE_DEC_WAV_SUPPORT=n
CONFIG_AUDIO_SIMPLE_DEC_M4A_SUPPORT=n
CONFIG_AUDIO_SIMPLE_DEC_TS_SUPPORT=n
CONFIG_AUDIO_ENCODER_AAC_SUPPORT=n
CONFIG_AUDIO_ENCODER_G711_SUPPORT=n
CONFIG_AUDIO_ENCODER_AMRNB_SUPPORT=n
CONFIG_AUDIO_ENCODER_AMRWB_SUPPORT=n
CONFIG_AUDIO_ENCODER_OPUS_SUPPORT=n
CONFIG_AUDIO_ENCODER_ADPCM_SUPPORT=n
CONFIG_AUDIO_ENCODER_ALAC_SUPPORT=n
CONFIG_AUDIO_ENCODER_PCM_SUPPORT=n
CONFIG_AUDIO_ENCODER_SBC_SUPPORT=n
CONFIG_AUDIO_ENCODER_LC3_SUPPORT=n
CONFIG_AUDIO_ENCODER_G722_SUPPORT=n

CONFIG_DAC_ISR_IRAM_SAFE=y
CONFIG_DAC_DMA_AUTO_16BIT_ALIGN=y

CONFIG_BT_ENABLED=n
CONFIG_BT_BLUEDROID_ENABLED=n
CONFIG_BT_NIMBLE_ENABLED=n
CONFIG_ESP_WIFI_SOFTAP_SUPPORT=y
CONFIG_ESP_WIFI_ENTERPRISE_SUPPORT=n
CONFIG_ESP_WIFI_ENABLE_WPA3_SAE=n
CONFIG_ESP_WIFI_ENABLE_SAE_PK=n
CONFIG_ESP_WIFI_ENABLE_WPA3_OWE_STA=n
CONFIG_LWIP_PPP_SUPPORT=n
CONFIG_LWIP_IPV6=n

CONFIG_ESP_HTTP_CLIENT_SAVE_RESPONSE_HEADERS=y
CONFIG_ESP_HTTP_CLIENT_MAX_SAVED_RESPONSE_HEADERS=8
CONFIG_ESP_HTTP_CLIENT_MAX_RESPONSE_HEADER_SIZE=128

CONFIG_SPIFFS_USE_MAGIC=y
CONFIG_SPIFFS_USE_MAGIC_LENGTH=y
CONFIG_SPIFFS_META_LENGTH=0
CONFIG_VFS_SUPPORT_SELECT=n
CONFIG_VFS_SUPPORT_TERMIOS=n
CONFIG_VFS_INITIALIZE_DEV_NULL=n
```
