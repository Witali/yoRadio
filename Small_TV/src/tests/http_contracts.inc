/* Additional scenarios share native_test.c's platform adapter and real handlers. */
static void rejected_setting(const char *uri, const char *body)
{
    /* A rejected request must leave configuration and deferred actions untouched. */
    tv_settings_t before, after;
    settings_snapshot(&before);
    unsigned restarts = restart_requests, updates = weather_requests;
    uint32_t generation = settings_generation();
    post(uri, body, 400);
    settings_snapshot(&after);
    CHECK(!memcmp(&before, &after, sizeof(before)));
    CHECK(settings_generation() == generation);
    CHECK(restart_requests == restarts && weather_requests == updates);
}

#include "http_targets.inc"

static void test_http_pages(void)
{
    /* Check every page alias against the real generated bytes in both Wi-Fi modes. */
    const char *setup[] = {"/", "/setup", "/setup.html"};
    connected = false;
    for (unsigned i = 0; i < 3; ++i)
    {
        get(setup[i]);
        CHECK(request.response_length == web_setup_length);
        CHECK(!memcmp(request.response, web_setup, web_setup_length));
        CHECK(!strcmp(request.response_type, "text/html; charset=utf-8"));
    }
    connected = true;
    const char *settings[] = {"/", "/settings", "/settings.html"};
    for (unsigned i = 0; i < 3; ++i)
    {
        get(settings[i]);
        CHECK(request.response_length == web_settings_length);
        CHECK(!memcmp(request.response, web_settings, web_settings_length));
    }
    /* Captions must describe the actual raw flags; the bounded brightness
     * control must represent both firmware endpoints without browser clamping. */
    CHECK(strstr((const char *)web_settings,"Show Temperature in Fahrenheit"));
    CHECK(!strstr((const char *)web_settings,"Show Temperature in Celsius"));
    CHECK(strstr((const char *)web_settings,"Wind speed in km/h:"));
    CHECK(strstr((const char *)web_settings,"name='ledBrightness' min='0' max='100'"));
    CHECK(strstr((const char *)web_settings,"aria-label=\"Browser time sync\" disabled"));
    CHECK(strstr((const char *)web_settings,"Clock settings could not be loaded. Reload to retry."));
    CHECK(!strstr((const char *)web_settings,"checked = true;  // 1=Fahrenheit"));
    for (unsigned i = 0; i < 2; ++i)
    {
        get(i ? "/photo.html" : "/photo");
        CHECK(request.response_length == web_photo_length);
        CHECK(!memcmp(request.response, web_photo, web_photo_length));
    }
    get("/advanced");
    CHECK(strstr(request.response, "/advancedset") != NULL);
    prepare("/generate_204", "", 0, NULL);
    dispatch(HTTP_GET);
    CHECK(request.status == 302 && !strcmp(request.location, "/") && request.response_length == 0);
    connected = false;
    get("/scan");
    CHECK(strstr(request.response, "native test") && strstr(request.response, "-42"));
    CHECK(!strcmp(request.response_type, "application/json; charset=utf-8") &&
          !strcmp(request.cache_control, "no-store"));
    scan_count = 0;
    CHECK(!strcmp(get("/scan"), "[]"));
    scan_count = 1;
    scan_result = ESP_FAIL;
    prepare("/scan", "", 0, NULL);
    dispatch(HTTP_GET);
    CHECK(request.status == 503);
    scan_result = ESP_OK;
}

static void test_http_ranges(void)
{
    /* The independent route table is the external API contract, not source introspection. */
    const struct
    {
        const char *post, *get, *key;
        int min, max;
        bool json;
    } ranges[] = {{"/setclocktype", "/getclocktype", "clocktype", 0, 3, false},
                  {"/setgifvalue", "/getgifvalue", "gif", 0, 4, false},
                  {"/SetTimeModeValue", "/GetTimeModeValue", "timemode", 0, 2, false},
                  {"/SetNightStartTime", "/GetNightStartTime", "StartTime", 18, 23, false},
                  {"/SetNightStopTime", "/GetNightStopTime", "StopTime", 5, 12, false},
                  {"/set_display_time", "/get_display_time", "display_time", 3, 60, true}};
    char body[256], expected[64];
    for (unsigned i = 0; i < sizeof(ranges) / sizeof(ranges[0]); ++i)
    {
        for (int n = ranges[i].min; n <= ranges[i].max; ++n)
        {
            snprintf(body, sizeof(body), "{\"%s\":%d}", ranges[i].key, n);
            post(ranges[i].post, body, 200);
            snprintf(expected, sizeof(expected), ranges[i].json ? "{\"displaytime\":%d}" : "%d", n);
            CHECK(!strcmp(get(ranges[i].get), expected));
            snprintf(body, sizeof(body), "{\"%s\":\"%d\"}", ranges[i].key, n);
            post(ranges[i].post, body, 200);
        }
        const char *invalid[] = {"null",   "true", "[]",     "{}",     "1.5",
                                 "\"1x\"", "\"\"", "\"+1\"", "\" 1\"", "1e300"};
        for (unsigned j = 0; j < sizeof(invalid) / sizeof(invalid[0]); ++j)
        {
            snprintf(body, sizeof(body), "{\"%s\":%s}", ranges[i].key, invalid[j]);
            rejected_setting(ranges[i].post, body);
        }
        snprintf(body, sizeof(body), "{\"%s\":%d}", ranges[i].key, ranges[i].min - 1);
        rejected_setting(ranges[i].post, body);
        snprintf(body, sizeof(body), "{\"%s\":%d}", ranges[i].key, ranges[i].max + 1);
        rejected_setting(ranges[i].post, body);
    }
    const char *switches[] = {"tempUnit", "hourFormat", "mileDisplay", "timeSync", "nightmode"};
    for (unsigned i = 0; i < 5; ++i)
    {
        for (unsigned n = 0; n < 2; ++n)
        {
            snprintf(body, sizeof(body), "{\"%s\":%u}", switches[i], n);
            post("/settings", body, 200);
            cJSON *reply = cJSON_Parse(get("/getsettings"));
            CHECK(reply != NULL);
            const cJSON *value = cJSON_GetObjectItemCaseSensitive(reply, switches[i]);
            CHECK(cJSON_IsNumber(value) && value->valueint == (int)n);
            cJSON_Delete(reply);
        }
        snprintf(body, sizeof(body), "{\"%s\":2}", switches[i]);
        rejected_setting("/settings", body);
    }
    rejected_setting("/settings", "{}");
    rejected_setting("/settings", "{\"nightmode\":0,\"hourFormat\":2}");
    for (unsigned night = 0; night < 2; ++night)
    {
        const char *uri = night ? "/set_night_brightness" : "/set_led_brightness",
                   *key = night ? "NightBrightness" : "ledBrightness",
                   *geturi = night ? "/get_night_brightness" : "/get_led_brightness";
        for (unsigned n = 0; n <= 100; ++n)
        {
            snprintf(body, sizeof(body), "%s=%u", key, n);
            post(uri, body, 200);
            cJSON *reply = cJSON_Parse(get(geturi));
            const cJSON *value = cJSON_GetObjectItemCaseSensitive(reply, "brightness");
            CHECK(cJSON_IsNumber(value) && value->valueint == (int)n);
            cJSON_Delete(reply);
        }
        const char *invalid[] = {"-1", "101", "1.1", "999999999999999999999", "abc", ""};
        for (unsigned j = 0; j < 6; ++j)
        {
            snprintf(body, sizeof(body), "%s=%s", key, invalid[j]);
            rejected_setting(uri, body);
        }
    }
    for (unsigned i = 0; i < 3; ++i)
    {
        snprintf(body, sizeof(body), "{\"index\":%u,\"color\":\"#Aa55Ff\"}", i);
        post("/set_clock_color", body, 200);
    }
    get("/get_clock_colors");
    CHECK(strstr(request.response, "#ad55ff") != NULL);
    rejected_setting("/set_clock_color", "{\"index\":0,\"color\":\"#gg0000\"}");
    rejected_setting("/set_clock_color", "{\"index\":-1,\"color\":\"#ffffff\"}");
    for (unsigned slot = 1; slot <= 5; ++slot)
        for (unsigned checked = 0; checked < 2; ++checked)
        {
            snprintf(body, sizeof(body), "{\"checkbox_id\":\"file%u-switch\",\"checked\":%s}", slot,
                     checked ? "true" : "false");
            post("/set_checkbox_state", body, 200);
            cJSON *reply = cJSON_Parse(get("/get_checkbox_state"));
            snprintf(expected, sizeof(expected), "file%u_switch", slot);
            CHECK(cJSON_IsTrue(cJSON_GetObjectItemCaseSensitive(reply, expected)) == (bool)checked);
            cJSON_Delete(reply);
        }
    rejected_setting("/set_checkbox_state", "{\"checkbox_id\":\"file6-switch\",\"checked\":true}");
    rejected_setting("/set_checkbox_state", "{\"checkbox_id\":\"file1-switch\",\"checked\":1}");
}

static void test_http_transport(void)
{
    /* Short reads are normal; a receive timeout closes reads, and origins must match. */
    const char *body = "{\"clocktype\":0}";
    prepare("/setclocktype", body, strlen(body), "application/json");
    request.origin = "http://192.168.43.1";
    request.recv_block_bytes = 1;
    dispatch(HTTP_POST);
    CHECK(request.status == 200 && request.position == strlen(body));
    tv_settings_t before, after;
    settings_snapshot(&before);
    for (unsigned mode = 0; mode < 5; ++mode)
    {
        prepare("/setclocktype", body, strlen(body), "application/json");
        if (mode == 0)
            request.recv_timeouts = 1;
        if (mode == 1)
            request.recv_disconnect = true;
        if (mode == 2)
            request.origin = "https://192.168.43.1";
        if (mode == 3)
            request.origin = "http://192.168.43.1.evil.example";
        if (mode == 4)
        {
            request.origin = "http://192.168.43.1";
            request.host = NULL;
        }
        dispatch(HTTP_POST);
        CHECK(request.status == 400);
        CHECK(request.read_shutdown && request.shutdown_calls == 1);
        settings_snapshot(&after);
        CHECK(!memcmp(&before, &after, sizeof(before)));
    }
    const char *bad[] = {"", "[]", "null", "{", "{\"clocktype\":0}junk"};
    for (unsigned i = 0; i < 5; ++i)
        rejected_setting("/setclocktype", bad[i]);
    char large[4098];
    memset(large, ' ', sizeof(large));
    large[4097] = 0;
    rejected_setting("/setclocktype", large);
    post("/restart", "", 200);
    unsigned restart = restart_requests;
    post("/restart", "{}", 200);
    CHECK(restart_requests == restart + 1);
    rejected_setting("/configure", "{\"ssid\":\"\",\"password\":\"\"}");
    rejected_setting("/configure", "{\"ssid\":\"test\",\"password\":\"1234567\"}");
    char ssid[34];
    memset(ssid, 's', 33);
    ssid[33] = 0;
    char json[256];
    snprintf(json, sizeof(json), "{\"ssid\":\"%s\",\"password\":\"\"}", ssid);
    rejected_setting("/configure", json);
    ssid[32] = 0;
    snprintf(json, sizeof(json), "{\"ssid\":\"%s\",\"password\":\"\"}", ssid);
    post("/configure", json, 200);
    post("/wifireset", "{\"ssid\":\"fixture\",\"password\":\"12345678\"}", 200);
    post("/updateCity", "{\"city\":\"Budapest，hu\"}", 200);
    settings_snapshot(&after);
    CHECK(!strcmp(after.city, "Budapest") && !strcmp(after.country, "HU"));
    rejected_setting("/updateCity", "{\"city\":\",GB\"}");
    rejected_setting("/updateCity", "{\"city\":\"London,G\"}");
    rejected_setting("/updateCity", "{\"city\":\"London,12\"}");
    post("/advancedset",
         "{\"ntp\":\"fixture.invalid\",\"openweathermapKey\":\"synthetic-key\",\"clickCount\":10}",
         200);
    rejected_setting("/advancedset",
                     "{\"ntp\":\"x\",\"openweathermapKey\":\"\",\"clickCount\":11}");
    CHECK(strstr(get("/getsettings"), "synthetic-key") == NULL);
    after.theme = 2;
    CHECK(settings_replace(&after) == ESP_OK);
    write_result = ESP_FAIL;
    CHECK(settings_flush() == ESP_FAIL);
    write_result = ESP_OK;
    CHECK(settings_flush() == ESP_OK);
    CHECK(settings_init() == ESP_OK);
    settings_snapshot(&after);
    CHECK(after.theme == 2 && !strcmp(after.ssid, "fixture"));
}

static void test_http_body_deadline(void)
{
    /* Progress cannot reset the total budget; failed reads never publish settings,
     * while valid fragments restore the socket's original keep-alive timeout. */
    const char *body = "{\"clocktype\":0}";
    prepare("/setclocktype", body, strlen(body), "application/json");
    request.recv_block_bytes = 1;
    request.recv_step_us = 100000;
    request.recv_timeout_us = 3000000;
    dispatch(HTTP_POST);
    CHECK(request.status == 200 && request.position == strlen(body));
    CHECK(request.recv_timeout_us == 3000000 && !request.read_shutdown);

    tv_settings_t before, after;
    settings_snapshot(&before);
    for (unsigned mode = 0; mode < 5; ++mode)
    {
        prepare("/setclocktype", body, strlen(body), "application/json");
        int64_t started = clock_us;
        if (mode == 0)
        {
            request.recv_block_bytes = 1;
            request.recv_step_us = 400000;
        }
        if (mode == 1)
        {
            request.recv_block_bytes = 1;
            request.recv_step_us = 4999500;
        }
        if (mode == 2)
            request.fail_timeout_get = true;
        if (mode == 3)
            request.fail_timeout_set_call = 1;
        if (mode == 4)
            request.fail_timeout_set_call = 2;
        dispatch(HTTP_POST);
        CHECK(request.status == 400 && request.read_shutdown && request.shutdown_calls == 1);
        settings_snapshot(&after);
        CHECK(!memcmp(&before, &after, sizeof(before)));
        if (mode < 2)
        {
            CHECK(clock_us - started >= 5000000 && clock_us - started <= 5001000);
            CHECK(request.position < strlen(body));
        }
        if (mode == 2 || mode == 3)
            CHECK(request.recv_calls == 0);
        if (mode == 4)
            CHECK(request.position == strlen(body));
    }
    prepare("/setclocktype", body, strlen(body), "application/json");
    request.recv_timeouts = 2;
    dispatch(HTTP_POST);
    CHECK(request.status == 400 && request.recv_calls == 1 && request.recv_timeouts == 1);
    CHECK(request.read_shutdown && request.shutdown_calls == 1);
}

static void test_http_photo_cycle(unsigned form)
{
    /* Upload through all three registered HTTP routes, then retrieve every original byte. */
    tv_settings_t s;
    settings_snapshot(&s);
    size_t length = s.photo_size[0];
    uint8_t *jpeg = malloc(length);
    CHECK(jpeg != NULL);
    memcpy(jpeg, flash_bytes, length);
    char json[160], body[6000], query[128], target[256];
    unsigned chunks = (unsigned)(length + 4095) / 4096;
    snprintf(json, sizeof(json), "{\"file_number\":5,\"file_size\":%zu,\"total_chunks\":%u}",
             length, chunks);
    post(http_target(target, sizeof(target), "/start_upload", form), json, 200);
    for (unsigned i = 0; i < chunks; ++i)
    {
        size_t bytes = length - i * 4096;
        if (bytes > 4096)
            bytes = 4096;
        size_t pos = append_part(body, 0, "file_number", "5", 1);
        char number[32];
        snprintf(number, sizeof(number), "%u", i);
        pos = append_part(body, pos, "chunk_index", number, strlen(number));
        snprintf(number, sizeof(number), "%u", chunks);
        pos = append_part(body, pos, "total_chunks", number, strlen(number));
        pos = append_part(body, pos, "chunk", jpeg + i * 4096, bytes);
        pos += sprintf(body + pos, "--test-boundary--\r\n");
        prepare(http_target(target, sizeof(target), "/upload_chunk", form), body, pos,
                "multipart/form-data; boundary=test-boundary");
        dispatch(HTTP_POST);
        CHECK(request.status == 200);
    }
    post(http_target(target, sizeof(target), "/finish_upload", form),
         "{\"file_number\":5,\"file_name\":\"file4.jpg\"}", 400);
    post(target, "{\"file_number\":5,\"file_name\":\"file5.jpg\"}", 200);
    get(http_target(target, sizeof(target), "/get_Photo_File?file=5&chunk=0&size=0", form));
    CHECK(strstr(request.response, "\"exists\":true"));
    for (unsigned i = 0; i < chunks; ++i)
    {
        snprintf(query, sizeof(query), "/get_Photo_File?file=5&chunk=%u&size=4096", i);
        get(http_target(target, sizeof(target), query, form));
        size_t bytes = length - i * 4096;
        if (bytes > 4096)
            bytes = 4096;
        CHECK(request.response_length == bytes &&
              !memcmp(request.response, jpeg + i * 4096, bytes));
        CHECK(!strcmp(request.response_type, "application/octet-stream"));
    }
    const char *invalid[] = {"/get_Photo_File", "/get_Photo_File?file=0&chunk=0&size=0",
                             "/get_Photo_File?file=6&chunk=0&size=0",
                             "/get_Photo_File?file=5&chunk=0&size=12289",
                             "/get_Photo_File?file=5&chunk=-1&size=1"};
    for (unsigned i = 0; i < 5; ++i)
    {
        prepare(invalid[i], "", 0, NULL);
        dispatch(HTTP_GET);
        CHECK(request.status == 400);
    }
    post("/start_upload", "{\"file_number\":6,\"file_size\":100,\"total_chunks\":1}", 400);
    free(jpeg);
}

static void test_http_contracts(void)
{
    /* Cover all 40 registered contracts, valid values and non-mutating failure paths. */
    test_http_pages();
    test_http_ranges();
    test_http_transport();
    test_http_body_deadline();
    test_http_uri_targets();
    for (unsigned form = 0; form < 4; ++form)
        test_http_photo_cycle(form);
    for (unsigned i = 0; i < registered_routes; ++i)
        if (route_table[i]->method == HTTP_POST && strcmp(route_table[i]->uri, "/restart"))
        {
            tv_settings_t before, after;
            settings_snapshot(&before);
            prepare(route_table[i]->uri, "{", 1, "application/json");
            dispatch(HTTP_POST);
            CHECK(request.status == 400);
            settings_snapshot(&after);
            CHECK(!memcmp(&before, &after, sizeof(before)));
        }
}

static void write_native_report(const char *path)
{
    /* Emit executed route coverage; a route counts only after a real successful response. */
    FILE *file = fopen(path, "wb");
    CHECK(file != NULL);
    fprintf(
        file,
        "{\"passed\":true,\"checks\":%u,\"groups\":[\"settings\",\"factory_settings\",\"weather_parser\",\"assets\",\"http_contracts\",\"uploads\",\"multipart\",\"dns\"],\"routes\":[",
        checks);
    for (unsigned i = 0; i < registered_routes; ++i)
        fprintf(file, "%s{\"method\":\"%s\",\"uri\":\"%s\",\"successes\":%u,\"errors\":%u}",
                i ? "," : "", route_table[i]->method == HTTP_GET ? "GET" : "POST",
                route_table[i]->uri, route_success[i], route_errors[i]);
    fprintf(file, "]}\n");
    fclose(file);
}
